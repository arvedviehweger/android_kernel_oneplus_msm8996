## drivers/platform/oneplus/Kconfig
```kconfig
# OnePlus configuration options

config MACH_ONEPLUS_MSM8996
	bool "OnePlus MSM8996"
	depends on ARCH_MSM8996
	help
	  Support for the OnePlus 3 (15801) and OnePlus 3T (15811)
```
